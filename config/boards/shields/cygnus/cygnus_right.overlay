/*
 * Copyright (c) 2023 The ZMK Contributors
 *
 * SPDX-License-Identifier: MIT
 */

#include "cygnus.dtsi"

&default_transform {
    col-offset = <6>;
};

/*
 * Use a custom transform matrix for the right side that reverses
 * the column positions for rows 0, 1, and 2 but keeps row 3 in the original
 * order. This is needed because the pin scanning behavior on the right half
 * requires different handling for different rows.
 */
/ {
    chosen {
        zmk,matrix_transform = &right_transform;
    };
};

&kscan0 {
    // Column pins for the right side need to be in REVERSE physical order
    // compared to the logical order in the matrix to handle the way
    // the scanning is performed on this half
    col-gpios
        = <&pro_micro 10 GPIO_ACTIVE_HIGH>    // rightmost column (physical col 5)
        , <&pro_micro 16 GPIO_ACTIVE_HIGH>    // physical col 4
        , <&pro_micro 14 GPIO_ACTIVE_HIGH>    // physical col 3
        , <&pro_micro 15 GPIO_ACTIVE_HIGH>    // physical col 2
        , <&pro_micro 18 GPIO_ACTIVE_HIGH>    // physical col 1
        , <&pro_micro 19 GPIO_ACTIVE_HIGH>    // leftmost column (physical col 0)
        ;
};